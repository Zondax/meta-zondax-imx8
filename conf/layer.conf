## conf/layer.conf
```bitbake
# We have a conf and classes directory, add to BBPATH
BBPATH .= ":${LAYERDIR}"
# We have recipes-* directories add to bbfiles
BBFILES += "${LAYERDIR}/recipes-*/*/*.bb \
	    ${LAYERDIR}/recipes-*/*/*.bbappend"

BBFILE_COLLECTIONS += "meta-zondax-imx8"
BBFILE_PATTERN_meta-zondax-imx8 = "^${LAYERDIR}/"
BBFILE_PRIORITY_meta-zondax-imx8 = "6"

LAYERSERIES_COMPAT_meta-zondax-imx8 = "honister"

PREFERRED_PROVIDER_virtual/optee-os = "optee-os"

PREFERRED_VERSION_optee-client:mx8 = ""
PREFERRED_VERSION_optee-test:mx8 = ""

ACCEPT_FSL_EULA = "1"

IMX_DEFAULT_BSP = "nxp"
```

## conf/machine/flex-pi-imx8mm.conf
```bitbake
#@TYPE: Machine
#@NAME: FLEX-PI-IMX8M-MINI
#@SOC: i.MX8MM
#@DESCRIPTION: Machine configuration for FLEX-IMX8M-MINI SOM on FLEX-PI baseboard

require conf/machine/tn-imx8mm.inc

KERNEL_DEVICETREE = " \
    freescale/imx8mm-flex-pi.dtb \
    freescale/overlays/imx8mm-flex-pi-tevi-ov5640.dtbo \
    freescale/overlays/imx8mm-flex-pi-ili9881c.dtbo \
    freescale/overlays/imx8mm-flex-pi-clixwifi.dtbo \
"

UBOOT_CONFIG ??= "sd"
UBOOT_CONFIG[sd] = "flex-imx8mm_defconfig,sdcard"
UBOOT_CONFIG[mfgtool] = "flex-imx8mm_defconfig"

# Set u-boot DTB
UBOOT_DTB_NAME = "imx8mm-flex-pi.dtb"
```

## conf/machine/flex-wizard-imx8mm.conf
```bitbake
#@TYPE: Machine
#@NAME: FLEX-WIZARD-IMX8M-MINI
#@SOC: i.MX8MM
#@DESCRIPTION: Machine configuration for FLEX-IMX8M-MINI SOM on FLEX-WIZARD baseboard

require conf/machine/tn-imx8mm.inc

KERNEL_DEVICETREE = " \
    freescale/imx8mm-flex-wizard.dtb \
    freescale/overlays/imx8mm-flex-wizard-tevi-ov5640.dtbo \
    freescale/overlays/imx8mm-flex-wizard-ili9881c.dtbo \
    freescale/overlays/imx8mm-flex-wizard-g080uan01.dtbo \
    freescale/overlays/imx8mm-flex-wizard-g101uan02.dtbo \
    freescale/overlays/imx8mm-flex-wizard-mipi2hdmi-adv7535.dtbo \
    freescale/overlays/imx8mm-flex-wizard-sn65dsi84-vl10112880.dtbo \
    freescale/overlays/imx8mm-flex-wizard-sn65dsi84-vl15613676.dtbo \
    freescale/overlays/imx8mm-flex-wizard-sn65dsi84-vl215192108.dtbo \
    freescale/overlays/imx8mm-flex-wizard-clix1wifi.dtbo \
    freescale/overlays/imx8mm-flex-wizard-clix1nfc.dtbo \
    freescale/overlays/imx8mm-flex-wizard-clix2nfc.dtbo \
"

UBOOT_CONFIG ??= "sd"
UBOOT_CONFIG[sd] = "flex-imx8mm_defconfig,sdcard"
UBOOT_CONFIG[mfgtool] = "flex-imx8mm_defconfig"

# Set u-boot DTB
UBOOT_DTB_NAME = "imx8mm-flex-wizard.dtb"
```

## conf/machine/imx8mm-evk-secure.conf
```bitbake
#@TYPE: Machine
#@NAME: NXP i.MX 8M Mini EVK with LPDDR4
#@SOC: i.MX8MM
#@DESCRIPTION: Machine configuration for NXP i.MX 8M Mini Evaluation Kit with LPDDR4 with Secure boot

require secure-boot.inc
require imx8mm-evk-zondax.inc
```

## conf/machine/imx8mm-evk-zondax.inc
```bitbake
MACHINEOVERRIDES =. "mx8:mx8m:mx8mm:"

require conf/machine/include/imx-base.inc
require conf/machine/include/arm/armv8a/tune-cortexa53.inc

MACHINE_FEATURES += "pci wifi bluetooth optee bcm43455 bcm4356 bcm4359"

MACHINE_SOCARCH_FILTER:append:mx8mm = " virtual/libopenvg virtual/libgles1 virtual/libgles2 virtual/egl virtual/mesa virtual/libgl virtual/libg2d"

KERNEL_DEVICETREE = " \
    freescale/imx8mm-evk.dtb \
    freescale/imx8mm-evk-pcie-ep.dtb \
    freescale/imx8mm-evk-rm67191.dtb \
    freescale/imx8mm-evk-8mic-revE.dtb \
    freescale/imx8mm-evk-8mic-swpdm.dtb \
    freescale/imx8mm-evk-ak4497.dtb \
    freescale/imx8mm-evk-ak5558.dtb \
    freescale/imx8mm-evk-audio-tdm.dtb \
    freescale/imx8mm-evk-inmate.dtb \
    freescale/imx8mm-evk-qca-wifi.dtb \
    freescale/imx8mm-evk-revb-qca-wifi.dtb \
    freescale/imx8mm-evk-root.dtb \
    freescale/imx8mm-evk-rpmsg.dtb \
    freescale/imx8mm-evk-usd-wifi.dtb \
"

IMX_DEFAULT_KERNEL:mx8mm = "linux-imx"

IMX_DEFAULT_BOOTLOADER = "u-boot-imx"

UBOOT_SUFFIX = "bin"

UBOOT_CONFIG ??= "sd"
UBOOT_CONFIG[sd] = "imx8mm_evk_defconfig,sdcard"
UBOOT_CONFIG[mfgtool] = "imx8mm_evk_defconfig"

SPL_BINARY = "spl/u-boot-spl.bin"

# Set DDR FIRMWARE
DDR_FIRMWARE_NAME = " \
    lpddr4_pmu_train_1d_imem.bin \
    lpddr4_pmu_train_1d_dmem.bin \
    lpddr4_pmu_train_2d_imem.bin \
    lpddr4_pmu_train_2d_dmem.bin \
"

# Set u-boot DTB
UBOOT_DTB_NAME = "imx8mm-evk.dtb"

# Set ATF platform name
ATF_PLATFORM = "imx8mm"
ATF_LOAD_ADDR = "0x920000"

# Extra firmware package name, that is required to build boot container for fslc bsp
IMX_EXTRA_FIRMWARE = "firmware-imx-8m"

# Set imx-mkimage boot target
IMXBOOT_TARGETS = "flash_evk flash_evk_no_hdmi"
IMX_BOOT_SOC_TARGET = "iMX8MM"

SERIAL_CONSOLES = "115200;ttymxc1"

LOADADDR = ""
UBOOT_MAKE_TARGET = "all"
IMX_BOOT_SEEK = "33"

OPTEE_BIN_EXT = "8mm"
TEE_LOAD_ADDR = "0xbe000000"

# Add additional firmware
MACHINE_FIRMWARE:append = " linux-firmware-ath10k"

KERNEL_CLASSES = " kernel-fitimage "
KERNEL_IMAGETYPE:aarch64 = "fitImage"
```

## conf/machine/imx8mq-evk-secure.conf
```bitbake
#@TYPE: Machine
#@NAME: NXP i.MX 8M Quad EVK
#@SOC: i.MX8MQ
#@DESCRIPTION: Machine configuration for NXP i.MX 8M Quad Evaluation Kit with Secure boot

require secure-boot.inc
require imx8mq-evk-zondax.inc
```

## conf/machine/imx8mq-evk-zondax.inc
```bitbake
MACHINEOVERRIDES =. "mx8:mx8m:mx8mq:"

require conf/machine/include/imx-base.inc
require conf/machine/include/arm/armv8a/tune-cortexa53.inc

MACHINE_FEATURES += "pci wifi bluetooth optee bcm43455 bcm4356 bcm4359"

MACHINE_SOCARCH_FILTER:append:mx8mq = " virtual/libopenvg virtual/libgles1 virtual/libgles2 virtual/egl virtual/mesa virtual/libgl virtual/libg2d"

KERNEL_DEVICETREE = " \
    freescale/imx8mq-evk.dtb \
    freescale/imx8mq-evk-ak4497.dtb \
    freescale/imx8mq-evk-audio-tdm.dtb \
    freescale/imx8mq-evk-dcss-adv7535.dtb \
    freescale/imx8mq-evk-dcss-rm67191.dtb \
    freescale/imx8mq-evk-dcss-rm67199.dtb \
    freescale/imx8mq-evk-dp.dtb \
    freescale/imx8mq-evk-dual-display.dtb \
    freescale/imx8mq-evk-inmate.dtb \
    freescale/imx8mq-evk-lcdif-adv7535.dtb \
    freescale/imx8mq-evk-lcdif-rm67191.dtb \
    freescale/imx8mq-evk-lcdif-rm67199.dtb \
    freescale/imx8mq-evk-pcie-ep.dtb \
    freescale/imx8mq-evk-pcie1-m2.dtb \
    freescale/imx8mq-evk-pdm.dtb \
    freescale/imx8mq-evk-root.dtb \
    freescale/imx8mq-evk-rpmsg.dtb \
    freescale/imx8mq-evk-usd-wifi.dtb \
    freescale/imx8mq-evk-usdhc2-m2.dtb \
"

IMX_DEFAULT_KERNEL:mx8mq = "linux-imx"

IMX_DEFAULT_BOOTLOADER = "u-boot-imx"

UBOOT_SUFFIX = "bin"

UBOOT_CONFIG ??= "sd"
UBOOT_CONFIG[sd] = "imx8mq_evk_config,sdcard"
UBOOT_CONFIG[mfgtool] = "imx8mq_evk_config"

SPL_BINARY = "spl/u-boot-spl.bin"

# Set DDR FIRMWARE
DDR_FIRMWARE_NAME = " \
    lpddr4_pmu_train_1d_imem.bin \
    lpddr4_pmu_train_1d_dmem.bin \
    lpddr4_pmu_train_2d_imem.bin \
    lpddr4_pmu_train_2d_dmem.bin \
"

# Set u-boot DTB
UBOOT_DTB_NAME = "imx8mq-evk.dtb"

# Set ATF platform name
ATF_PLATFORM = "imx8mq"

# Extra firmware package name, that is required to build boot container for fslc bsp
IMX_EXTRA_FIRMWARE = "firmware-imx-8m"

# Set imx-mkimage boot target
IMXBOOT_TARGETS = "flash_evk flash_evk_no_hdmi flash_dp_evk"
IMX_BOOT_SOC_TARGET = "iMX8M"

SERIAL_CONSOLES = "115200;ttymxc0"

LOADADDR = ""
UBOOT_MAKE_TARGET = ""
IMX_BOOT_SEEK = "33"

OPTEE_BIN_EXT = "8mq"

# Add additional firmware
MACHINE_FIRMWARE:append = " linux-firmware-ath10k"

KERNEL_CLASSES = " kernel-fitimage "
KERNEL_IMAGETYPE:aarch64 = "fitImage"
```

## conf/machine/pico-pi-imx8mm-secure.conf
```bitbake
#@TYPE: Machine
#@NAME: PICO-PI-IMX8M-MINI
#@SOC: i.MX8MM
#@DESCRIPTION: Machine configuration for PICO-IMX8M-MINI SOM on PICO-PI baseboard with Secure boot

require secure-boot.inc
require tn-imx8mm-zondax.inc

KERNEL_DEVICETREE = " \
    freescale/imx8mm-pico-pi.dtb \
    freescale/overlays/imx8mm-pico-pi-tevi-ov5640.dtbo \
    freescale/overlays/imx8mm-pico-pi-ov5645.dtbo \
    freescale/overlays/imx8mm-pico-pi-ili9881c.dtbo \
"

UBOOT_CONFIG ??= "sd"
UBOOT_CONFIG[sd] = "pico-imx8mm_defconfig,sdcard"
UBOOT_CONFIG[mfgtool] = "pico-imx8mm_defconfig"

# Set u-boot DTB
UBOOT_DTB_NAME = "imx8mm-pico-pi.dtb"
```

## conf/machine/pico-pi-imx8mq.conf
```bitbake
#@TYPE: Machine
#@NAME: PICO-PI-IMX8M
#@SOC: i.MX8MQ
#@DESCRIPTION: Machine configuration for PICO-IMX8M SOM on PICO-PI baseboard

require conf/machine/tn-imx8mq.inc

KERNEL_DEVICETREE = " \
    freescale/imx8mq-pico-pi.dtb \
    freescale/overlays/imx8mq-pico-pi-ili9881c.dtbo \
    freescale/overlays/imx8mq-pico-pi-dual.dtbo \
    freescale/overlays/imx8mq-pico-pi-tevi-ov5640.dtbo \
    freescale/overlays/imx8mq-pico-pi-ov5645.dtbo \
"

UBOOT_CONFIG ??= "sd"
UBOOT_CONFIG[sd] = "pico-imx8mq_defconfig,sdcard"
UBOOT_CONFIG[mfgtool] = "pico-imx8mq_defconfig"

# Set u-boot DTB
UBOOT_DTB_NAME = "imx8mq-pico-pi.dtb"
```

## conf/machine/pico-wizard-imx8mm.conf
```bitbake
#@TYPE: Machine
#@NAME: PICO-WIZARD-IMX8M-MINI
#@SOC: i.MX8MM
#@DESCRIPTION: Machine configuration for PICO-IMX8M-MINI SOM on PICO-WIZARD baseboard

require conf/machine/tn-imx8mm.inc

KERNEL_DEVICETREE = " \
    freescale/imx8mm-pico-wizard.dtb \
    freescale/overlays/imx8mm-pico-wizard-ili9881c.dtbo \
    freescale/overlays/imx8mm-pico-wizard-mipi2hdmi-adv7535.dtbo \
    freescale/overlays/imx8mm-pico-wizard-g080uan01.dtbo \
    freescale/overlays/imx8mm-pico-wizard-g101uan02.dtbo \
    freescale/overlays/imx8mm-pico-wizard-sn65dsi84-vl10112880.dtbo \
    freescale/overlays/imx8mm-pico-wizard-sn65dsi84-vl15613676.dtbo \
    freescale/overlays/imx8mm-pico-wizard-sn65dsi84-vl215192108.dtbo \
    freescale/overlays/imx8mm-pico-wizard-tevi-ov5640.dtbo \
    freescale/overlays/imx8mm-pico-wizard-ov5645.dtbo \
"

UBOOT_CONFIG ??= "sd"
UBOOT_CONFIG[sd] = "pico-imx8mm_defconfig,sdcard"
UBOOT_CONFIG[mfgtool] = "pico-imx8mm_defconfig"

# Set u-boot DTB
UBOOT_DTB_NAME = "imx8mm-pico-wizard.dtb"
```

## conf/machine/pico-wizard-imx8mq-secure.conf
```bitbake
#@TYPE: Machine
#@NAME: PICO-WIZARD-IMX8M
#@SOC: i.MX8MQ
#@DESCRIPTION: Machine configuration for PICO-IMX8M SOM on PICO-WIZARD baseboard with Secure boot

require conf/machine/secure-boot.inc
require conf/machine/tn-imx8mq-zondax.inc

KERNEL_DEVICETREE = " \
    freescale/imx8mq-pico-wizard.dtb \
    freescale/overlays/imx8mq-pico-wizard-ili9881c.dtbo \
    freescale/overlays/imx8mq-pico-wizard-g080uan01.dtbo \
    freescale/overlays/imx8mq-pico-wizard-g101uan02.dtbo \
    freescale/overlays/imx8mq-pico-wizard-sn65dsi84-vl10112880.dtbo \
    freescale/overlays/imx8mq-pico-wizard-sn65dsi84-vl15613676.dtbo \
    freescale/overlays/imx8mq-pico-wizard-sn65dsi84-vl215192108.dtbo \
    freescale/overlays/imx8mq-pico-wizard-mipi2hdmi-adv7535.dtbo \
    freescale/overlays/imx8mq-pico-wizard-tevi-ov5640.dtbo \
    freescale/overlays/imx8mq-pico-wizard-ov5645.dtbo \
"

UBOOT_CONFIG ??= "sd"
UBOOT_CONFIG[sd] = "pico-imx8mq_defconfig,sdcard"
UBOOT_CONFIG[mfgtool] = "pico-imx8mq_defconfig"

# Set u-boot DTB
UBOOT_DTB_NAME = "imx8mq-pico-wizard.dtb"
```

## conf/machine/secure-boot.inc
```bitbake
# Enable bootloader verification
HAB_SIGN_ENABLE ?= "1"
HAB_GENERATE_KEYS ?= "1"
HAB_SIGN_CA_KEYNAME ?= "root-ca"
HAB_SIGN_SRK_KEYNAME ?= "root-srk"
HAB_SIGN_CSF_KEYNAME ?= "root-csf"
HAB_SIGN_IMG_KEYNAME ?= "root-img"
HAB_SIGN_KEYDIR ?= "${TOPDIR}/keys"
HAB_SIGN_KEY_PASS ?= "dummy"

# Enable kernel verification
FIT_GENERATE_KEYS ?= "1"
FIT_SIGN_INDIVIDUAL ?= "1"
UBOOT_SIGN_ENABLE ?= "1"
UBOOT_SIGN_KEYNAME ?= "kernel-fit-conf"
UBOOT_SIGN_IMG_KEYNAME ?= "kernel-fit-image"
UBOOT_SIGN_KEYDIR ?= "${TOPDIR}/keys"
UBOOT_MKIMAGE_DTCOPTS ?= "-I dts -O dtb -p 0x1000"
```

## conf/machine/tn-imx8mq-zondax.inc
```bitbake
MACHINEOVERRIDES =. "mx8:mx8m:mx8mq:"

require conf/machine/include/imx-base.inc
require conf/machine/include/arm/armv8a/tune-cortexa53.inc

MACHINE_FEATURES += "pci wifi bluetooth optee"

MACHINE_SOCARCH_FILTER:append:mx8mq = " virtual/libopenvg virtual/libgles1 virtual/libgles2 virtual/egl virtual/mesa virtual/libgl virtual/libg2d"

IMX_DEFAULT_KERNEL:mx8mq = "linux-tn-imx"

EXTRA_OEMAKE:append:pn-linux-tn-imx = " DTC_FLAGS='-@ -H epapr'"

IMX_DEFAULT_BOOTLOADER = "u-boot-tn-imx"

UBOOT_SUFFIX = "bin"

SPL_BINARY = "spl/u-boot-spl.bin"

# Set DDR FIRMWARE
DDR_FIRMWARE_NAME = " \
    lpddr4_pmu_train_1d_imem.bin \
    lpddr4_pmu_train_1d_dmem.bin \
    lpddr4_pmu_train_2d_imem.bin \
    lpddr4_pmu_train_2d_dmem.bin \
"

# Set ATF platform name
ATF_PLATFORM = "imx8mq"

# Extra firmware package name, that is required to build boot container for fslc bsp
IMX_EXTRA_FIRMWARE = "firmware-imx-8m"

# Set imx-mkimage boot target
IMXBOOT_TARGETS = "flash_evk flash_evk_no_hdmi flash_dp_evk"
IMX_BOOT_SOC_TARGET = "iMX8M"

SERIAL_CONSOLES = "115200;ttymxc0"

LOADADDR = ""
UBOOT_SUFFIX = "bin"
UBOOT_MAKE_TARGET = ""
IMX_BOOT_SEEK = "33"

OPTEE_BIN_EXT = "8mq"

KERNEL_CLASSES = " kernel-fitimage "
KERNEL_IMAGETYPE:aarch64 = "fitImage"
```
